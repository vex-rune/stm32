/**
  ******************************************************************************
  * @file    lcd.c
  * @brief   LCD 驱动实现 (FSMC 8080 接口, ILI9486 控制器, Z350IT002 320x480)
  *
  * @note
  *   本文件实现 lcd.h 中声明的所有 API。依赖 STM32 HAL 库提供的 FSMC
  *   总线读写, 寄存器时序由 MX_FSMC_Init() 配置。
  *
  *   数据宽度: 16-bit (RGB565)
  *   命令/数据切换: 通过 FSMC 地址线 A10 (PG0) 实现
  *     - LCD_REG (0x6C000000) -> A10=0 -> 写命令
  *     - LCD_RAM (0x6C000800) -> A10=1 -> 写数据
  *
  *   接线:
  *     FSMC_D0  ~ FSMC_D15  -> 数据线
  *     FSMC_NE4 -> PG12     -> LCD CS
  *     FSMC_NOE -> PD4      -> LCD RD
  *     FSMC_NWE -> PD5      -> LCD WR
  *     FSMC_A10 -> PG0      -> LCD RS (命令/数据)
  *     PB0      -> LCD BL   -> 背光
  *     PG15     -> LCD RST  -> 复位
  *
  *   调用顺序 (main.c 中):
  *     1. HAL_Init();
  *     2. SystemClock_Config();
  *     3. MX_GPIO_Init();    // 初始化 PB0 / PG15
  *     4. MX_FSMC_Init();    // 初始化 FSMC 总线
  *     5. LCD_Init();        // 本文件提供的初始化
  *     6. LCD_Clear(WHITE);  // 清屏
  *     7. LCD_ShowString(...)// 显示内容
  ******************************************************************************
  */
#include "lcd.h"

#include <stdio.h>
/* 本文件不再需要标准库: pow 用整数运算, memcpy/strcpy 未使用 */

/*============================================================================
 * 内部宏定义
 *============================================================================*/

/**
 * @def LCD_WRITE_CMD(reg)
 * @brief  写命令到 LCD (A10=0, 控制器视为命令)
 */
#define LCD_WRITE_CMD(reg)     LCD_REG = (reg)

/**
 * @def LCD_WRITE_DATA(data)
 * @brief  写 16-bit 数据到 LCD (A10=1, 控制器视为 GRAM 数据)
 */
#define LCD_WRITE_DATA(data)   LCD_RAM = (data)

/**
 * @def LCD_READ_DATA()
 * @brief  从 LCD 读取一个 16-bit 数据 (ILI9486 用 16-bit 数据接口时)
 */
#define LCD_READ_DATA()        LCD_RAM

/*============================================================================
 * 全局设备对象
 *============================================================================*/

/** @brief 全局 LCD 设备对象, 记录当前屏幕的尺寸/方向/控制器 ID 等 */
_lcd_dev lcddev;

/*============================================================================
 * 8x16 ASCII 字模表 (0x20 ~ 0x7F, 共 96 字符)
 *
 * 取模说明:
 *   - 纵向取模, 字模宽度 = 8 像素 (即 1 字节宽度)
 *   - 字节位序: MSB -> 左列像素, LSB -> 右列像素
 *   - 每字符占 16 字节, 每字节对应 1 行像素 (共 16 行)
 *   - 取模顺序: 从上到下, 从左到右
 *
 *   显示函数 LCD_ShowChar 逐字节读出, 每字节从高位到低位依次写点,
 *   1 表示点亮 (color), 0 表示背景 (BLACK 或 保持)。
 *
 *   0x20 ~ 0x7F 范围覆盖: 空格, 标点, 数字 0~9, 大小写字母, 常用符号。
 *============================================================================*/
static const unsigned char ascii_8x16[] = {
    0x00, 0x00, 0x00, 0x00, 0x00, 0x00, 0x00, 0x00, 0x00, 0x00, 0x00, 0x00, 0x00, 0x00, 0x00, 0x00, // sp
    0x00, 0x00, 0x00, 0xF8, 0x00, 0x00, 0x00, 0x00, 0x00, 0x00, 0x00, 0x38, 0x00, 0x00, 0x00, 0x00, // !
    0x00, 0x08, 0x06, 0x00, 0x08, 0x06, 0x00, 0x00, 0x00, 0x00, 0x00, 0x00, 0x00, 0x00, 0x00, 0x00, // "
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    0x00, 0x00, 0x00, 0x00, 0x00, 0x00, 0x00, 0x00, 0x00, 0x00, 0x00, 0x00, 0x00, 0x00, 0x00, 0x00 // del
};

/*============================================================================
 * 私有函数 (static, 仅本文件可见)
 *============================================================================*/

/**
 * @brief  写 LCD 命令寄存器
 * @param  reg  命令代码 (16-bit, ILI9486 几乎所有命令都是 8-bit, 高 8 位忽略)
 * @note   通过 FSMC 对 LCD_REG 地址写入, 控制器把该值作为命令识别
 */
static void lcd_write_reg(uint16_t reg)
{
    LCD_REG = reg;
}

/**
 * @brief  写 16-bit 数据到 LCD (用于设置窗口坐标/GRAM 像素等)
 * @param  data  16-bit 数据
 * @note   ILI9486 大多数数据操作使用 16-bit 接口 (RGB565, 坐标值)
 */
static void lcd_write_data(uint16_t data)
{
    LCD_RAM = data;
}

/**
 * @brief  写 8-bit 数据到 LCD (用于初始化序列中部分 8-bit 参数寄存器)
 * @param  data  8-bit 数据
 * @note   当 R0x3A = 0x55 (DPI=101) 时, 数据总线低 8 位有效,
 *         控制器仅读取 DBI[7:0]。本项目 16-bit 总线直接写低 8 位即可。
 */
static void lcd_write_data8(uint8_t data)
{
    LCD_RAM = (uint16_t)data;
}

/** 读取
 */
static uint16_t lcd_read_data(void)
{
    return LCD_RAM;
}

/*============================================================================
 * ILI9486 初始化序列 (适配 Z350IT002 320x480 模块)
 *============================================================================*/

/**
 * @brief  ILI9486 复位 + 寄存器配置
 */
static void lcd_init_sequence(void)
{
    /* 1) 硬件复位 */
    LCD_RST_CLR();
    HAL_Delay(20);
    LCD_RST_SET();
    HAL_Delay(20);
    LCD_BL_SET();
    HAL_Delay(20);

    /* 2) 软件复位 + Sleep Out */
    lcd_write_reg(0x01);
    HAL_Delay(120);
    lcd_write_reg(0x11);
    HAL_Delay(120);

    /* 3) 像素格式: 16-bit RGB565 */
    lcd_write_reg(0x3A);
    lcd_write_data8(0x55);

    /* 4) 电源控制 */
    lcd_write_reg(0xC0);
    lcd_write_data8(0x10);
    lcd_write_data8(0x10);
    lcd_write_reg(0xC1);
    lcd_write_data8(0x41);
    lcd_write_reg(0xC5);
    lcd_write_data8(0x00);
    lcd_write_data8(0x22);
    lcd_write_data8(0x80);

    /* 5) 显示方向: BGR=1 */
    lcd_write_reg(0x36);
    lcd_write_data8(0x08);

    /* 6) 显示功能 */
    lcd_write_reg(0xB6);
    lcd_write_data8(0x02);
    lcd_write_data8(0x02);
    lcd_write_data8(0x3B);
    lcd_write_reg(0xB7);
    lcd_write_data8(0xC6);
    lcd_write_reg(0xBE);
    lcd_write_data8(0x00);
    lcd_write_data8(0x04);
    lcd_write_reg(0xB4);
    lcd_write_data8(0x02);

    /* 7) 帧率 70Hz */
    lcd_write_reg(0xB1);
    lcd_write_data8(0xB0);
    lcd_write_data8(0x11);

    /* 8) RGB 接口关闭 (使用 MCU 接口) */
    lcd_write_reg(0xB3);
    lcd_write_data8(0x02);
    lcd_write_data8(0x00);
    lcd_write_data8(0x00);
    lcd_write_data8(0x00);

    /* 9) Gamma 校正 */
    lcd_write_reg(0xF2);
    lcd_write_data8(0x00);
    lcd_write_reg(0x26);
    lcd_write_data8(0x01);

    /* R0xE0: Positive Gamma */
    lcd_write_reg(0xE0);
    lcd_write_data8(0x0F);
    lcd_write_data8(0x1E);
    lcd_write_data8(0x1C);
    lcd_write_data8(0x0A);
    lcd_write_data8(0x0F);
    lcd_write_data8(0x08);
    lcd_write_data8(0x47);
    lcd_write_data8(0xB3);
    lcd_write_data8(0x3B);
    lcd_write_data8(0x0A);
    lcd_write_data8(0x14);
    lcd_write_data8(0x06);
    lcd_write_data8(0x0E);
    lcd_write_data8(0x09);
    lcd_write_data8(0x00);

    /* R0xE1: Negative Gamma */
    lcd_write_reg(0xE1);
    lcd_write_data8(0x0F);
    lcd_write_data8(0x36);
    lcd_write_data8(0x2F);
    lcd_write_data8(0x0A);
    lcd_write_data8(0x0F);
    lcd_write_data8(0x06);
    lcd_write_data8(0x47);
    lcd_write_data8(0xB3);
    lcd_write_data8(0x3A);
    lcd_write_data8(0x0A);
    lcd_write_data8(0x14);
    lcd_write_data8(0x06);
    lcd_write_data8(0x0E);
    lcd_write_data8(0x09);
    lcd_write_data8(0x00);

    /* 10) Display ON */
    lcd_write_reg(0x29);
    HAL_Delay(50);
}


/*============================================================================
 * 对外函数实现
 *============================================================================*/

/**
 * @brief  LCD 总初始化
 *
 * 执行步骤:
 *   1. 填写 lcddev 结构体 (Z350IT002 -> ILI9486, 320x480, 竖屏)
 *   2. 硬件复位 + ILI9486 寄存器初始化序列
 *   3. 设置显示方向
 *   4. 点亮背光
 *   5. 清屏 (白色)
 *
 * @note   调用前必须先完成 MX_GPIO_Init() 和 MX_FSMC_Init()
 * @warning 本函数包含不短延 ( ~ 200ms), 必要时可以在初始化阶段调用
 */
void LCD_Init(void)
{
    // 基础信息
    lcddev.id = 0x9486; /* Z350IT002 -> ILI9486 控制器 */
    lcddev.width = 320; /* 默认竖屏 320 x 480 */
    lcddev.height = 480;
    lcddev.dir = LCD_DIR_VERTICAL;


    /* 复位 : 先拉低, 在拉高*/
    LCD_RST_CLR();
    LCD_RST_SET();

    /* 打开背光 */
    LCD_BL_SET();

    /* 初始化序列 */
    lcd_init_sequence();

    // 初始化寄存器的值
    LCD_DisplayDir(lcddev.dir); /* 根据方向更新 lcddev.width/height */
    LCD_Clear(WHITE); /* 清屏 */
}

// 测试屏幕方向
void LCD_TestDir(void)
{
    LCD_Write_Font('1', 1, 0, 0, RED); // (0, 0)
    LCD_Write_Font('2', 1, lcddev.width - 8, 0, RED); // 期望右上 (代码语义)
    LCD_Write_Font('3', 1, 0, lcddev.height - 16, RED); // 期望左下
    LCD_Write_Font('4', 1, lcddev.width - 8, lcddev.height - 16, RED); // 期望右下
    LCD_Write_Font('5', 1, lcddev.width / 2 - 4, lcddev.height / 2 - 8, RED); // 期望中心
}


/**
 * @brief  打开 LCD 显示 (等同于 R0x29: Display ON)
 */
void LCD_DisplayOn(void)
{
    lcd_write_reg(0x29);
}

/**
 * @brief  关闭 LCD 显示 (等同于 R0x28: Display OFF)
 * @note   进入 Display OFF 后控制逻辑仍在运行, 仅不输出图像
 */
void LCD_DisplayOff(void)
{
    lcd_write_reg(0x28);
}


/**
 * @brief  设置 GRAM 绘图窗口
 * @param  xstar,ystar  窗口左上角
 * @param  xend,yend    窗口右下角
 * @note   设置窗口后, 后续 LCD_RAM 写入将自动按窗口顺序填充,
 *         适合批量绘制 (例如填充矩形, 显示大字符)。使用完窗口后
 *         建议调用 LCD_SetWindow(0, 0, width-1, height-1) 恢复全屏。
 */
void LCD_SetWindow(uint16_t xstar, uint16_t ystar, uint16_t w, uint16_t h)
{
    // 设置窗口
    // 列地址
    lcd_write_reg(0x2a);

    // 开始列
    lcd_write_data(xstar >> 8);
    lcd_write_data(xstar & 0xFF);

    // 计算结束列
    uint16_t xend = xstar + w - 1;
    // 结束列
    lcd_write_data(xend >> 8);
    lcd_write_data(xend & 0xFF);

    // 行地址
    lcd_write_reg(0x2b);

    // 开始行
    lcd_write_data(ystar >> 8);
    lcd_write_data(ystar & 0xFF);

    // 计算结束行
    uint16_t yend = ystar + h - 1;
    // 结束行
    lcd_write_data(yend >> 8);
    lcd_write_data(yend & 0xFF);
}


/**
 * @brief  全屏填充单一颜色
 * @param  color  RGB565 颜色
 *
 * 实现要点:
 *   - 调用 LCD_SetWindow 设置全屏窗口
 *   - 发送 R0x2C (Write GRAM) 命令
 *   - 连续写入 width*height 个颜色值
 *
 * @warning 总写入量 = width * height, 在 320x240 屏为 76800 次。
 *          通过 FSMC 直接写寄存器, 速度极快, 不需要使用 DMA。
 */
void LCD_Clear(uint16_t color)
{
    // 设置全屏
    LCD_SetWindow(0, 0, lcddev.width - 1, lcddev.height - 1);

    // 发送 GRAM 命令
    lcd_write_reg(0x2c);

    // 设置所有像素点, 注意 lcddev.width * lcddev.height 的大小, 所以用 uint32_t
    for (uint32_t i = 0; i < lcddev.width * lcddev.height; i++)
    {
        lcd_write_data(color);
    }
}


/**
 * @brief  设置 LCD 扫描方向 (ILI9341 R0x36 MADCTL)
 * @param  dir  0~7 对应 8 种扫描方式
 *
 * R0x36 位域含义 (bit7~bit5):
 *   MY (bit7) - 行地址顺序
 *   MX (bit6) - 列地址顺序
 *   MV (bit5) - 行/列交换
 *   ML (bit4) - 垂直刷新顺序
 *   BGR (bit3) - RGB->BGR 顺序
 *   MH (bit2) - 水平刷新顺序
 *
 * 常用组合:
 *   0 -> 竖屏 RGB
 *   5 -> 横屏 RGB
 *   6 -> 竖屏 RGB 反向
 *   3 -> 横屏 RGB 反向
 */
void LCD_ScanDir(uint8_t dir)
{
    uint16_t regval = 0;
    switch (dir)
    {
    case 0: regval = (0 << 7) | (0 << 6) | (0 << 5);
        break; /* MY=0,MX=0,MV=0 */
    case 1: regval = (0 << 7) | (1 << 6) | (0 << 5);
        break; /* MY=0,MX=1,MV=0 */
    case 2: regval = (1 << 7) | (0 << 6) | (1 << 5);
        break; /* MY=1,MX=0,MV=1 */
    case 3: regval = (1 << 7) | (1 << 6) | (1 << 5);
        break; /* MY=1,MX=1,MV=1 */
    case 4: regval = (0 << 7) | (0 << 6) | (1 << 5);
        break; /* MY=0,MX=0,MV=1 */
    case 5: regval = (0 << 7) | (1 << 6) | (1 << 5);
        break; /* MY=0,MX=1,MV=1 */
    case 6: regval = (1 << 7) | (0 << 6) | (0 << 5);
        break; /* MY=1,MX=0,MV=0 */
    case 7: regval = (1 << 7) | (1 << 6) | (0 << 5);
        break; /* MY=1,MX=1,MV=0 */
    }
    regval |= 0x08; /* 强制 BGR=1 (ILI9341 默认数据顺序为 BGR) */
    lcd_write_reg(0x36);
    lcd_write_data8(regval);
}

/**
 * @brief  设置显示方向, 同时同步更新 lcddev.width/height
 * @param  dir  LCD_DIR_HORIZONTAL(横屏 320x240) / LCD_DIR_VERTICAL(竖屏 240x320)
 * @note   调用后, 之前设置的窗口/光标已失效, 需重新调用 LCD_SetWindow
 */
void LCD_DisplayDir(uint8_t dir)
{
    if (dir == LCD_DIR_HORIZONTAL)
    {
        lcddev.width = 480; /* 横屏: 宽 480, 高 320 */
        lcddev.height = 320;
        LCD_ScanDir(5); /* 横屏: MY=0,MX=1,MV=1,BGR=1 */
    }
    else
    {
        lcddev.width = 320; /* 竖屏: 宽 320, 高 480 (Z350IT002 物理方向) */
        lcddev.height = 480;
        LCD_ScanDir(1); /* 竖屏: MY=0,MX=0,MV=0,BGR=1 */
    }
    lcddev.dir = dir;
}

/**
 * 读取 id
 *
 * 是个3字节的数据类型
 */
uint32_t LCD_ReadID(void)
{
    lcd_write_reg(0x04);

    // 每次只能读 1 个字节, 一共是 3 个字节
    uint32_t id = 0;

    id |= (lcd_read_data() & 0xFF) << 24;
    id |= (lcd_read_data() & 0xFF) << 16;
    id |= (lcd_read_data() & 0xFF) << 8;
    id |= (lcd_read_data() & 0xFF);

    return id;
}

void do_row(int size, int w, uint16_t color, uint8_t row)
{
    for (int j = 0; j < w; j++)
    {
        int f = row & 0x80;
        // 获取当前像素点
        if (f)
        {
            for (int k = 0; k < size; k++)
            {
                lcd_write_data(color);
            }
        }
        else
        {
            for (int k = 0; k < size; k++)
            {
                lcd_write_data(WHITE);
            }
        }
        row <<= 1;
    }
}

// 8x16
void LCD_Write_Font(char str, int size, uint16_t x, uint16_t y, uint16_t color)
{
    // 1. 范围保护: 仅支持 0x20 ~ 0x7F
    unsigned char c = (unsigned char)str;
    if (c < 0x20 || c > 0x7F)
    {
        return;
    }

    int f_w = 8;
    int f_h = 16;
    int w = 8 * size;
    int h = 16 * size;


    // 2. 确定区域 (16 行 x 8 列)
    LCD_SetWindow(x, y, w, h);

    // 3. 发送写 GRAM 指令
    lcd_write_reg(0x2c);

    // 4. 计算字符起始字节偏移: ' ' 对应 0, 'A' 对应 (0x41-0x20)*16 = 528
    int begin_index = (c - 0x20) * f_h;

    // 遍历每一行
    for (int i = 0; i < f_h; i++)
    {
        uint8_t row = ascii_8x16[begin_index + i];

        for (int i = 0; i < size; ++i)
        {
            do_row(size, f_w, color, row);
        }
    }
}

void LCD_Write_Fonts(char* str, int size, int len, uint16_t x, uint16_t y, uint16_t color)
{
    for (int i = 0; i < len; i++)
    {
        LCD_Write_Font(str[i], size, (x + i * 8) * size, y, color);
    }
}

void LCD_Write_C(const uint8_t font_c[], int size, uint16_t x, uint16_t y, uint16_t color)
{
    // 0) 边界检查
    if (font_c == 0 || size <= 0)
    {
        return;
    }
    if (x + 16 * size > lcddev.width || y + 16 * size > lcddev.height)
    {
        return;
    }

    // 1) 字模尺寸: 高 16 行, 宽 16 位 (每行 2 字节)
    //    注意: do_row 内部仅按 uint8_t (8 位) 处理, 所以下面传 w=8, 调用 2 次
    const int f_w_byte = 8;          // 每个字节 = 8 列
    const int f_h = 16;              // 16 行
    const int w = 16 * size;         // 总像素宽
    const int h = 16 * size;         // 总像素高

    // 2) 设置窗口 (16 行 x 16 列, 按 size 放大)
    LCD_SetWindow(x, y, w, h);

    // 3) 发送写 GRAM 指令
    lcd_write_reg(0x2c);

    // 4) 遍历每一行: 每行读 2 字节 (左半行 + 右半行)
    for (int row_idx = 0; row_idx < f_h; row_idx++)
    {
        uint8_t row_left  = font_c[row_idx * 2];      // 高字节 (左半行, MSB 在左)
        uint8_t row_right = font_c[row_idx * 2 + 1];  // 低字节 (右半行)

        // 5) 沿垂直方向放大 size 倍
        for (int s = 0; s < size; s++)
        {
            do_row(size, f_w_byte, color, row_left);   // 前 8 列
            do_row(size, f_w_byte, color, row_right);  // 后 8 列
        }
    }
}
